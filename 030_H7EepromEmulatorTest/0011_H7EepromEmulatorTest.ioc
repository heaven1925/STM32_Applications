# file: 0011_H7EepromEmulatorTest.ioc
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Mcu.Family=STM32H7
Mcu.Name=STM32H750VBTx
Mcu.Package=LQFP100
NVIC.PriorityGroup=NVIC_PRIORITYGROUP_4
PD13.Signal=GPIO_Output
ProjectManager.HeapSize=0x200
ProjectManager.StackSize=0x400
ProjectManager.TargetToolchain=STM32CubeIDE
RCC.ADCFreq_Value=129000000
RCC.APB1Freq_Value=84000000
RCC.APB2Freq_Value=84000000
RCC.APB3Freq_Value=84000000
RCC.APB4Freq_Value=84000000
RCC.CortexFreq_Value=84000000
RCC.DIVM1=4
RCC.DIVN1=10
RCC.HCLKFreq_Value=84000000
RCC.PLL2FRACN=0
RCC.PLL3FRACN=0
RCC.PLLFRACN=4096
RCC.SYSCLKFreq_VALUE=84000000
RCC.SYSCLKSource=RCC_SYSCLKSOURCE_PLLCLK
RCC.USBFreq_Value=84000000
board=custom

// file: Core/Src/main.c
/* USER CODE BEGIN Header */
/**
  ******************************************************************************
  * @file           : main.c
  * @brief          : Main program body
  ******************************************************************************
  * @attention
  *
  * Copyright (c) 2023 STMicroelectronics.
  * All rights reserved.
  *
  * This software is licensed under terms that can be found in the LICENSE file
  * in the root directory of this software component.
  * If no LICENSE file comes with this software, it is provided AS-IS.
  *
  ******************************************************************************
  */
/* USER CODE END Header */
#include "main.h"

void SystemClock_Config(void);
static void MX_GPIO_Init(void);

/* USER CODE BEGIN 0 */
FLASH_OBProgramInitTypeDef OBInit;

uint16_t VirtAddVarTab[NB_OF_VAR] = {0x5555, 0x6666, 0x7777};
uint16_t VarDataTab[NB_OF_VAR] = {0xDEAD, 0xBEEF, 0xEFFE};
uint16_t VarValue = 0xABCD;
uint16_t VarDataTmp = 0x1234;

/* USER CODE END 0 */

int main(void)
{

  /* MCU Configuration--------------------------------------------------------*/

  /* Reset of all peripherals, Initializes the Flash interface and the Systick. */
  HAL_Init();

  /* Configure the system clock */
  SystemClock_Config();

  /* Initialize all configured peripherals */
  MX_GPIO_Init();
  /* USER CODE BEGIN 2 */

  HAL_FLASH_Unlock();

  if( EE_Init() != EE_OK)
  {
      Error_Handler();
  }

  HAL_GPIO_TogglePin(GPIOD, GPIO_PIN_13);

  /* --- Store successively many values of the three variables in the EEPROM ---*/
    /* Store 0x1000 values of Variable1 in EEPROM */
    for (VarValue = 1; VarValue <= 0x1000; VarValue++)
    {
      /* Sequence 1 */
      if((EE_WriteVariable(VirtAddVarTab[0],  VarValue)) != HAL_OK)
      {
        Error_Handler();
      }

      if((EE_ReadVariable(VirtAddVarTab[0],  &VarDataTab[0])) != HAL_OK)
      {
        Error_Handler();
      }
      if (VarValue != VarDataTab[0])
      {
        Error_Handler();
      }

      /* Sequence 2 */
      if(EE_WriteVariable(VirtAddVarTab[1], ~VarValue) != HAL_OK)
      {
        Error_Handler();
      }

      if(EE_ReadVariable(VirtAddVarTab[1],  &VarDataTab[1]) != HAL_OK)
      {
        Error_Handler();
      }
      if(((uint16_t)~VarValue) != VarDataTab[1])
      {
        Error_Handler();
      }
      /* Toggle LED3 */
      HAL_GPIO_TogglePin(GPIOD, GPIO_PIN_13);
      /* Sequence 3 */
      if(EE_WriteVariable(VirtAddVarTab[2],  VarValue << 1) != HAL_OK)
      {
        Error_Handler();
      }

      if(EE_ReadVariable(VirtAddVarTab[2],  &VarDataTab[2]) != HAL_OK)
      {
        Error_Handler();
      }
      if ((VarValue << 1) != VarDataTab[2])
      {
        Error_Handler();
      }
      /* Toggle LED3 */
      HAL_GPIO_TogglePin(GPIOD, GPIO_PIN_13);

    }

    /* read the last stored variables data*/
    if(EE_ReadVariable(VirtAddVarTab[0], &VarDataTmp) != HAL_OK)
    {
      Error_Handler();
    }

    if (VarDataTmp != VarDataTab[0])
    {
      Error_Handler();
    }

    if(EE_ReadVariable(VirtAddVarTab[1], &VarDataTmp) != HAL_OK)
    {
      Error_Handler();
    }

    if (VarDataTmp != VarDataTab[1])
    {
      Error_Handler();
    }

    if(EE_ReadVariable(VirtAddVarTab[2], &VarDataTmp) != HAL_OK)
    {
      Error_Handler();
    }

    if (VarDataTmp != VarDataTab[2])
    {
      Error_Handler();
    }
    /* Toggle LED3 */
    HAL_GPIO_TogglePin(GPIOD, GPIO_PIN_13);

    /* Store 0x3000 values of Variable3 in EEPROM */
    for (VarValue = 1; VarValue <= 0x3000; VarValue++)
    {
      if(EE_WriteVariable(VirtAddVarTab[2], VarValue) != HAL_OK)
      {
        Error_Handler();
      }

      if(EE_ReadVariable(VirtAddVarTab[2], &VarDataTab[2]) != HAL_OK)
      {
        Error_Handler();
      }
      if(VarValue != VarDataTab[2])
      {
        Error_Handler();
      }
      /* Toggle LED3 */
      HAL_GPIO_TogglePin(GPIOD, GPIO_PIN_13);
    }

    /* read the last stored variables data*/
    if(EE_ReadVariable(VirtAddVarTab[0], &VarDataTmp) != HAL_OK)
    {
      Error_Handler();
    }

    if (VarDataTmp != VarDataTab[0])
    {
      Error_Handler();
    }

    if(EE_ReadVariable(VirtAddVarTab[1], &VarDataTmp) != HAL_OK)
    {
      Error_Handler();
    }
    if (VarDataTmp != VarDataTab[1])
    {
      Error_Handler();
    }

    /* Toggle LED3 */
    HAL_GPIO_TogglePin(GPIOD, GPIO_PIN_13);

    if(EE_ReadVariable(VirtAddVarTab[2], &VarDataTmp) != HAL_OK)
    {
      Error_Handler();
    }
    if (VarDataTmp != VarDataTab[2])
    {
      Error_Handler();
    }

  /* USER CODE END 2 */

  /* Infinite loop */
  while (1)
  {

  }
}

void SystemClock_Config(void)
{
  RCC_OscInitTypeDef RCC_OscInitStruct = {0};
  RCC_ClkInitTypeDef RCC_ClkInitStruct = {0};

  /** Supply configuration update enable
  */
  HAL_PWREx_ConfigSupply(PWR_LDO_SUPPLY);

  /** Configure the main internal regulator output voltage
  */
  __HAL_PWR_VOLTAGESCALING_CONFIG(PWR_REGULATOR_VOLTAGE_SCALE3);

  while(!__HAL_PWR_GET_FLAG(PWR_FLAG_VOSRDY)) {}

  /** Initializes the RCC Oscillators according to the specified parameters
  * in the RCC_OscInitTypeDef structure.
  */
  RCC_OscInitStruct.OscillatorType = RCC_OSCILLATORTYPE_HSI;
  RCC_OscInitStruct.HSIState = RCC_HSI_DIV1;
  RCC_OscInitStruct.HSICalibrationValue = RCC_HSICALIBRATION_DEFAULT;
  RCC_OscInitStruct.PLL.PLLState = RCC_PLL_ON;
  RCC_OscInitStruct.PLL.PLLSource = RCC_PLLSOURCE_HSI;
  RCC_OscInitStruct.PLL.PLLM = 4;
  RCC_OscInitStruct.PLL.PLLN = 10;
  RCC_OscInitStruct.PLL.PLLP = 2;
  RCC_OscInitStruct.PLL.PLLQ = 2;
  RCC_OscInitStruct.PLL.PLLR = 2;
  RCC_OscInitStruct.PLL.PLLRGE = RCC_PLL1VCIRANGE_3;
  RCC_OscInitStruct.PLL.PLLVCOSEL = RCC_PLL1VCOMEDIUM;
  RCC_OscInitStruct.PLL.PLLFRACN = 4096;
  if (HAL_RCC_OscConfig(&RCC_OscInitStruct) != HAL_OK)
  {
    Error_Handler();
  }

  /** Initializes the CPU, AHB and APB buses clocks
  */
  RCC_ClkInitStruct.ClockType = RCC_CLOCKTYPE_HCLK|RCC_CLOCKTYPE_SYSCLK
                              |RCC_CLOCKTYPE_PCLK1|RCC_CLOCKTYPE_PCLK2
                              |RCC_CLOCKTYPE_D3PCLK1|RCC_CLOCKTYPE_D1PCLK1;
  RCC_ClkInitStruct.SYSCLKSource = RCC_SYSCLKSOURCE_PLLCLK;
  RCC_ClkInitStruct.SYSCLKDivider = RCC_SYSCLK_DIV1;
  RCC_ClkInitStruct.AHBCLKDivider = RCC_HCLK_DIV1;
  RCC_ClkInitStruct.APB3CLKDivider = RCC_APB3_DIV1;
  RCC_ClkInitStruct.APB1CLKDivider = RCC_APB1_DIV1;
  RCC_ClkInitStruct.APB2CLKDivider = RCC_APB2_DIV1;
  RCC_ClkInitStruct.APB4CLKDivider = RCC_APB4_DIV1;

  if (HAL_RCC_ClockConfig(&RCC_ClkInitStruct, FLASH_LATENCY_1) != HAL_OK)
  {
    Error_Handler();
  }
}

static void MX_GPIO_Init(void)
{
  GPIO_InitTypeDef GPIO_InitStruct = {0};

  /* GPIO Ports Clock Enable */
  __HAL_RCC_GPIOD_CLK_ENABLE();

  /*Configure GPIO pin Output Level */
  HAL_GPIO_WritePin(GPIOD, GPIO_PIN_13, GPIO_PIN_RESET);

  /*Configure GPIO pin : PD13 */
  GPIO_InitStruct.Pin = GPIO_PIN_13;
  GPIO_InitStruct.Mode = GPIO_MODE_OUTPUT_PP;
  GPIO_InitStruct.Pull = GPIO_NOPULL;
  GPIO_InitStruct.Speed = GPIO_SPEED_FREQ_LOW;
  HAL_GPIO_Init(GPIOD, &GPIO_InitStruct);

}

void Error_Handler(void)
{
  __disable_irq();
  while (1)
  {
  }
}
